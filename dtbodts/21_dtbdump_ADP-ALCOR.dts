/dts-v1/;

/ {
	compatible = "qcom,sa8155-adp-alcor", "qcom,sa8155", "qcom,adp-alcor";
	model = "ADP-ALCOR";
	qcom,board-id = <0x2000019 0x0>;

	__fixups__ {
		CPU0 = "/fragment@3/__overlay__/pm8150_2_tz/cooling-maps/trip0_cpu0:cooling-device:0", "/fragment@3/__overlay__/pm8150_2_tz/cooling-maps/trip1_cpu0:cooling-device:0", "/fragment@3/__overlay__/pm8150_tz/cooling-maps/trip0_cpu0:cooling-device:0", "/fragment@3/__overlay__/pm8150_tz/cooling-maps/trip1_cpu0:cooling-device:0";
		CPU1 = "/fragment@3/__overlay__/pm8150_2_tz/cooling-maps/trip1_cpu1:cooling-device:0", "/fragment@3/__overlay__/pm8150_tz/cooling-maps/trip1_cpu1:cooling-device:0";
		CPU2 = "/fragment@3/__overlay__/pm8150_2_tz/cooling-maps/trip1_cpu2:cooling-device:0", "/fragment@3/__overlay__/pm8150_tz/cooling-maps/trip1_cpu2:cooling-device:0";
		CPU3 = "/fragment@3/__overlay__/pm8150_2_tz/cooling-maps/trip1_cpu3:cooling-device:0", "/fragment@3/__overlay__/pm8150_tz/cooling-maps/trip1_cpu3:cooling-device:0";
		CPU4 = "/fragment@3/__overlay__/pm8150_2_tz/cooling-maps/trip1_cpu4:cooling-device:0", "/fragment@3/__overlay__/pm8150_tz/cooling-maps/trip1_cpu4:cooling-device:0";
		CPU5 = "/fragment@3/__overlay__/pm8150_2_tz/cooling-maps/trip1_cpu5:cooling-device:0", "/fragment@3/__overlay__/pm8150_tz/cooling-maps/trip1_cpu5:cooling-device:0";
		CPU6 = "/fragment@3/__overlay__/pm8150_2_tz/cooling-maps/trip1_cpu6:cooling-device:0", "/fragment@3/__overlay__/pm8150_tz/cooling-maps/trip1_cpu6:cooling-device:0";
		CPU7 = "/fragment@3/__overlay__/pm8150_2_tz/cooling-maps/trip1_cpu7:cooling-device:0", "/fragment@3/__overlay__/pm8150_tz/cooling-maps/trip1_cpu7:cooling-device:0";
		bt_en_active = "/fragment@4/__overlay__/bt_qca6174:pinctrl-0:0";
		clock_rpmh = "/fragment@0/__overlay__/qcom,pm8150@0/clock-controller@5b00:clocks:0", "/fragment@2/__overlay__/qcom,pm8150@4/clock-controller@5b00:clocks:0";
		cnss_wlan_en_active = "/fragment@4/__overlay__/qcom,cnss-qca-converged:pinctrl-0:0";
		cnss_wlan_en_sleep = "/fragment@4/__overlay__/qcom,cnss-qca-converged:pinctrl-1:0";
		conn_power_1p8_active = "/fragment@4/__overlay__/vreg_conn_1p8:pinctrl-0:0";
		conn_power_pa_active = "/fragment@4/__overlay__/vreg_conn_pa:pinctrl-0:0";
		mdss_mdp = "/fragment@30:target:0";
		pcie1 = "/fragment@25:target:0";
		pcie_rc1 = "/fragment@24:target:0", "/fragment@26:target:0", "/fragment@32:target:0";
		pil_modem = "/fragment@13:target:0";
		pm8150_1_l10 = "/fragment@16/__overlay__:vcc-supply:0";
		pm8150_1_l17 = "/fragment@17/__overlay__:vdd-supply:0";
		pm8150_1_s4 = "/fragment@16/__overlay__:vccq2-supply:0";
		pm8150_1_s6 = "/fragment@4/__overlay__/bt_qca6174:qca,bt-vdd-vl-supply:0", "/fragment@4/__overlay__/qcom,cnss-qca-converged:vdd-wlan-aon-supply:0";
		pm8150_2_l13 = "/fragment@17/__overlay__:vdd-io-supply:0";
		pm8150_2_l15 = "/fragment@4/__overlay__/bt_qca6174:qca,bt-vdd-vh-supply:0", "/fragment@4/__overlay__/qcom,cnss-qca-converged:vdd-wlan-rfa3-supply:0";
		pm8150_2_l16 = "/fragment@12/__overlay__/asm330@6a:vdd-supply:0", "/fragment@33/__overlay__/asm330@6a:vdd-supply:0";
		pm8150_2_l5 = "/fragment@16/__overlay__:qcom,vddp-ref-clk-supply:0";
		pm8150_2_l7 = "/fragment@12/__overlay__/asm330@6a:vio-supply:0", "/fragment@33/__overlay__/asm330@6a:vio-supply:0";
		pm8150_2_l8 = "/fragment@15/__overlay__:vdda-pll-supply:0";
		pm8150_2_s4 = "/fragment@4/__overlay__/bt_qca6174:qca,bt-vdd-vm-supply:0", "/fragment@4/__overlay__/qcom,cnss-qca-converged:vdd-wlan-rfa1-supply:0";
		pm8150_2_s5 = "/fragment@4/__overlay__/bt_qca6174:qca,bt-vdd-5c-supply:0", "/fragment@4/__overlay__/qcom,cnss-qca-converged:vdd-wlan-rfa2-supply:0";
		qupv3_3 = "/fragment@5:target:0";
		qupv3_se0_spi = "/fragment@6:target:0", "/fragment@31:target:0";
		qupv3_se10_i2c = "/fragment@12:target:0", "/fragment@33:target:0";
		qupv3_se12_2uart = "/fragment@7:target:0";
		qupv3_se13_4uart = "/fragment@8:target:0";
		qupv3_se3_spi = "/fragment@9:target:0";
		qupv3_se4_2uart = "/fragment@11:target:0";
		qupv3_se4_i2c = "/fragment@10:target:0";
		sdc2_clk_off = "/fragment@17/__overlay__:pinctrl-1:0";
		sdc2_clk_on = "/fragment@17/__overlay__:pinctrl-0:0";
		sdc2_cmd_off = "/fragment@17/__overlay__:pinctrl-1:4";
		sdc2_cmd_on = "/fragment@17/__overlay__:pinctrl-0:4";
		sdc2_data_off = "/fragment@17/__overlay__:pinctrl-1:8";
		sdc2_data_on = "/fragment@17/__overlay__:pinctrl-0:8";
		sde_dp = "/fragment@28:target:0", "/fragment@30/__overlay__:connectors:4";
		sde_rscc = "/fragment@30/__overlay__:connectors:0";
		sdhc_2 = "/fragment@17:target:0";
		sensor_int1_default = "/fragment@12/__overlay__/asm330@6a:pinctrl-0:0", "/fragment@33/__overlay__/asm330@6a:pinctrl-0:0";
		sensor_int2_default = "/fragment@12/__overlay__/asm330@6a:pinctrl-0:4", "/fragment@33/__overlay__/asm330@6a:pinctrl-0:4";
		shared_meta = "/fragment@23:target:0";
		soc = "/fragment@4:target:0", "/fragment@14:target:0", "/fragment@29:target:0";
		spmi_bus = "/fragment@0:target:0", "/fragment@2:target:0";
		ss5_pwr_ctrl_rst_on = "/fragment@14/__overlay__/ss5_pwr_ctrl0:pinctrl-0:0";
		thermal_zones = "/fragment@1:target:0", "/fragment@3:target:0";
		tlmm = "/fragment@4/__overlay__/vreg_conn_1p8:gpio:0", "/fragment@4/__overlay__/vreg_conn_pa:gpio:0", "/fragment@4/__overlay__/bt_qca6174:qca,bt-reset-gpio:0", "/fragment@4/__overlay__/qcom,cnss-qca-converged:wlan-en-gpio:0", "/fragment@6/__overlay__/can-controller@0:interrupt-parent:0", "/fragment@12/__overlay__/asm330@6a:interrupt-parent:0", "/fragment@14/__overlay__/ss5_pwr_ctrl0:ssVreset-gpio:0", "/fragment@14/__overlay__/ss5_pwr_ctrl0:ssVonoff-gpio:0", "/fragment@27:target:0", "/fragment@28/__overlay__:qcom,dp-hpd-gpio:0", "/fragment@33/__overlay__/asm330@6a:interrupt-parent:0";
		ufs_phy_gdsc = "/fragment@16/__overlay__:vdd-hba-supply:0";
		ufshc_mem = "/fragment@16:target:0";
		ufsphy_mem = "/fragment@15:target:0";
		usb0 = "/fragment@18:target:0";
		usb1 = "/fragment@21:target:0";
		usb2_phy0 = "/fragment@18/__overlay__/dwc3@a600000:usb-phy:0", "/fragment@19:target:0";
		usb2_phy1 = "/fragment@22:target:0";
		usb2phy_ac_en1_default = "/fragment@19/__overlay__:pinctrl-0:0";
		usb2phy_ac_en2_default = "/fragment@22/__overlay__:pinctrl-0:0";
		usb_nop_phy = "/fragment@18/__overlay__/dwc3@a600000:usb-phy:4";
		usb_qmp_dp_phy = "/fragment@20:target:0";
	};

	__local_fixups__ {

		fragment@0 {

			__overlay__ {

				qcom,pm8150@0 {

					adc_tm@3500 {
						io-channels = <0x0 0x8 0x10>;
					};

					qcom,temp-alarm@2400 {
						io-channels = <0x0>;
					};
				};
			};
		};

		fragment@1 {

			__overlay__ {

				pm8150_tz {
					thermal-sensors = <0x0>;
				};
			};
		};

		fragment@14 {

			__overlay__ {

				gpio_keys {
					pinctrl-0 = <0x0 0x4>;

					home {
						gpios = <0x0>;
					};

					vol_up {
						gpios = <0x0>;
					};
				};
			};
		};

		fragment@17 {

			__overlay__ {
				cd-gpios = <0x0>;
				pinctrl-0 = <0xc>;
				pinctrl-1 = <0xc>;
			};
		};

		fragment@2 {

			__overlay__ {

				qcom,pm8150@4 {

					qcom,temp-alarm@2400 {
						io-channels = <0x0>;
					};
				};
			};
		};

		fragment@28 {

			__overlay__ {
				pinctrl-0 = <0x0 0x4>;
				pinctrl-1 = <0x0 0x4>;
				pinctrl-2 = <0x0 0x4>;
				qcom,ext-disp = <0x0>;
			};
		};

		fragment@3 {

			__overlay__ {

				pm8150_2_tz {
					thermal-sensors = <0x0>;

					cooling-maps {

						trip0_cpu0 {
							trip = <0x0>;
						};

						trip1_cpu0 {
							trip = <0x0>;
						};

						trip1_cpu1 {
							trip = <0x0>;
						};

						trip1_cpu2 {
							trip = <0x0>;
						};

						trip1_cpu3 {
							trip = <0x0>;
						};

						trip1_cpu4 {
							trip = <0x0>;
						};

						trip1_cpu5 {
							trip = <0x0>;
						};

						trip1_cpu6 {
							trip = <0x0>;
						};

						trip1_cpu7 {
							trip = <0x0>;
						};
					};
				};

				pm8150_tz {

					cooling-maps {

						trip0_cpu0 {
							trip = <0x0>;
						};

						trip1_cpu0 {
							trip = <0x0>;
						};

						trip1_cpu1 {
							trip = <0x0>;
						};

						trip1_cpu2 {
							trip = <0x0>;
						};

						trip1_cpu3 {
							trip = <0x0>;
						};

						trip1_cpu4 {
							trip = <0x0>;
						};

						trip1_cpu5 {
							trip = <0x0>;
						};

						trip1_cpu6 {
							trip = <0x0>;
						};

						trip1_cpu7 {
							trip = <0x0>;
						};
					};
				};
			};
		};

		fragment@30 {

			__overlay__ {
				connectors = <0x8>;
			};
		};

		fragment@4 {

			__overlay__ {

				bt_qca6174 {
					qca,bt-chip-pwd-supply = <0x0>;
					qca,bt-vdd-pa-supply = <0x0>;
				};

				qcom,cnss-qca-converged {
					vdd-wlan-ctrl1-supply = <0x0>;
					vdd-wlan-ctrl2-supply = <0x0>;
					vdd-wlan-supply = <0x0>;
				};
			};
		};
	};

	__symbols__ {
		aqc_rc1 = "/fragment@24/__overlay__/aquantia,aqc107@pcie_rc1";
		aqc_x4 = "/fragment@32/__overlay__/aquantia,aqc107@pcie_rc1";
		bluetooth = "/fragment@4/__overlay__/bt_qca6174";
		cnss_pcie = "/fragment@4/__overlay__/qcom,cnss-qca-converged";
		dp_hpd_cfg_pins = "/fragment@27/__overlay__/dp_hpd_cfg_pins";
		dp_redriver_en = "/fragment@27/__overlay__/dp_redriver_en";
		ext_disp = "/fragment@29/__overlay__/qcom,msm-ext-disp";
		ext_disp_audio_codec = "/fragment@29/__overlay__/qcom,msm-ext-disp/qcom,msm-ext-disp-audio-codec-rx";
		ipa_hw = "/fragment@14/__overlay__/qcom,ipa@1e00000";
		key_home_default = "/fragment@0/__overlay__/qcom,pm8150@0/pinctrl@c000/key_home/key_home_default";
		key_vol_up_default = "/fragment@0/__overlay__/qcom,pm8150@0/pinctrl@c000/key_vol_up/key_vol_up_default";
		nvme_x8 = "/fragment@26/__overlay__/qcom,nvme@pcie_rc1";
		pm8150_1_clkdiv = "/fragment@0/__overlay__/qcom,pm8150@0/clock-controller@5b00";
		pm8150_1_gpios = "/fragment@0/__overlay__/qcom,pm8150@0/pinctrl@c000";
		pm8150_1_rtc = "/fragment@0/__overlay__/qcom,pm8150@0/qcom,pm8150_rtc";
		pm8150_1_tz = "/fragment@0/__overlay__/qcom,pm8150@0/qcom,temp-alarm@2400";
		pm8150_2_clkdiv = "/fragment@2/__overlay__/qcom,pm8150@4/clock-controller@5b00";
		pm8150_2_gpios = "/fragment@2/__overlay__/qcom,pm8150@4/pinctrl@c000";
		pm8150_2_temp_alarm = "/fragment@3/__overlay__/pm8150_2_tz";
		pm8150_2_trip0 = "/fragment@3/__overlay__/pm8150_2_tz/trips/trip0";
		pm8150_2_trip1 = "/fragment@3/__overlay__/pm8150_2_tz/trips/trip1";
		pm8150_2_tz = "/fragment@2/__overlay__/qcom,pm8150@4/qcom,temp-alarm@2400";
		pm8150_2_vadc = "/fragment@2/__overlay__/qcom,pm8150@4/vadc@3100";
		pm8150_adc_tm = "/fragment@0/__overlay__/qcom,pm8150@0/adc_tm@3500";
		pm8150_clkdiv = "/fragment@0/__overlay__/qcom,pm8150@0/clock-controller@5b00";
		pm8150_gpios = "/fragment@0/__overlay__/qcom,pm8150@0/pinctrl@c000";
		pm8150_rtc = "/fragment@0/__overlay__/qcom,pm8150@0/qcom,pm8150_rtc";
		pm8150_sdam_2 = "/fragment@0/__overlay__/qcom,pm8150@0/sdam@b100";
		pm8150_temp_alarm = "/fragment@1/__overlay__/pm8150_tz";
		pm8150_trip0 = "/fragment@1/__overlay__/pm8150_tz/trips/trip0";
		pm8150_trip1 = "/fragment@1/__overlay__/pm8150_tz/trips/trip1";
		pm8150_tz = "/fragment@0/__overlay__/qcom,pm8150@0/qcom,temp-alarm@2400";
		pm8150_vadc = "/fragment@0/__overlay__/qcom,pm8150@0/vadc@3100";
		refgen = "/fragment@29/__overlay__/refgen-regulator@88e7000";
		sde_wb = "/fragment@29/__overlay__/qcom,wb-display@0";
		ssc_sensors = "/fragment@14/__overlay__/qcom,msm-ssc-sensors";
		storage_cd_default = "/fragment@0/__overlay__/qcom,pm8150@0/pinctrl@c000/storage_sd_detect/storage_cd_default";
		vreg_conn_1p8 = "/fragment@4/__overlay__/vreg_conn_1p8";
		vreg_conn_pa = "/fragment@4/__overlay__/vreg_conn_pa";
		vreg_wlan = "/fragment@4/__overlay__/vreg_wlan";
	};

	fragment@0 {
		target = <0xffffffff>;

		__overlay__ {
			#address-cells = <0x2>;
			#size-cells = <0x0>;

			qcom,pm8150@0 {
				#address-cells = <0x2>;
				#size-cells = <0x0>;
				compatible = "qcom,spmi-pmic";
				reg = <0x0 0x0>;

				adc_tm@3500 {
					#address-cells = <0x1>;
					#size-cells = <0x0>;
					#thermal-sensor-cells = <0x1>;
					compatible = "qcom,adc-tm5";
					interrupt-names = "thr-int-en";
					interrupts = <0x0 0x35 0x0 0x1>;
					io-channels = <0x1 0x4c 0x1 0x4d 0x1 0x4e>;
					phandle = <0x17>;
					reg = <0x3500 0x100>;
				};

				clock-controller@5b00 {
					#clock-cells = <0x1>;
					clock-names = "xo";
					clock-output-names = "pm8150_1_div_clk1", "pm8150_1_div_clk2";
					clocks = <0xffffffff 0x0>;
					compatible = "qcom,spmi-clkdiv";
					phandle = <0x14>;
					qcom,num-clkdivs = <0x2>;
					reg = <0x5b00 0x200>;
				};

				pinctrl@c000 {
					#gpio-cells = <0x2>;
					compatible = "qcom,spmi-gpio";
					gpio-controller;
					interrupt-names = "pm8150_1_gpio1", "pm8150_1_gpio3", "pm8150_1_gpio4", "pm8150_1_gpio6", "pm8150_1_gpio9", "pm8150_1_gpio10";
					interrupts = <0x0 0xc0 0x0 0x0 0x0 0xc2 0x0 0x0 0x0 0xc3 0x0 0x0 0x0 0xc5 0x0 0x0 0x0 0xc8 0x0 0x0 0x0 0xc9 0x0 0x0>;
					phandle = <0xe>;
					qcom,gpios-disallowed = <0x2 0x5 0x7 0x8>;
					reg = <0xc000 0xa00>;

					key_home {

						key_home_default {
							bias-pull-up;
							function = "normal";
							input-enable;
							phandle = <0xc>;
							pins = "gpio1";
							power-source = <0x0>;
						};
					};

					key_vol_up {

						key_vol_up_default {
							bias-pull-up;
							function = "normal";
							input-enable;
							phandle = <0xd>;
							pins = "gpio6";
							power-source = <0x1>;
						};
					};

					storage_sd_detect {

						storage_cd_default {
							bias-pull-up;
							function = "normal";
							input-enable;
							phandle = <0xf>;
							pins = "gpio4";
							power-source = <0x0>;
						};
					};
				};

				qcom,pm8150_rtc {
					#address-cells = <0x1>;
					#size-cells = <0x1>;
					compatible = "qcom,qpnp-rtc";
					phandle = <0x15>;
					qcom,qpnp-rtc-alarm-pwrup = <0x0>;
					qcom,qpnp-rtc-write = <0x0>;

					qcom,pm8150_rtc_alarm@6100 {
						interrupts = <0x0 0x61 0x1 0x0>;
						reg = <0x6100 0x100>;
					};

					qcom,pm8150_rtc_rw@6000 {
						reg = <0x6000 0x100>;
					};
				};

				qcom,power-on@800 {
					compatible = "qcom,qpnp-power-on";
					interrupt-names = "kpdpwr", "resin";
					interrupts = <0x0 0x8 0x0 0x0 0x0 0x8 0x1 0x0>;
					qcom,kpdpwr-sw-debounce;
					qcom,pon-dbc-delay = <0x3d09>;
					qcom,store-hard-reset-reason;
					qcom,system-reset;
					reg = <0x800 0x100>;

					qcom,pon_1 {
						linux,code = <0x74>;
						qcom,pon-type = <0x0>;
						qcom,pull-up;
					};

					qcom,pon_2 {
						linux,code = <0x72>;
						qcom,pon-type = <0x1>;
						qcom,pull-up;
					};
				};

				qcom,temp-alarm@2400 {
					#thermal-sensor-cells = <0x0>;
					compatible = "qcom,spmi-temp-alarm";
					interrupts = <0x0 0x24 0x0 0x1>;
					io-channel-names = "thermal";
					io-channels = <0x1 0x6>;
					phandle = <0x2>;
					qcom,temperature-threshold-set = <0x1>;
					reg = <0x2400 0x100>;
				};

				sdam@b100 {
					compatible = "qcom,spmi-sdam";
					phandle = <0x16>;
					reg = <0xb100 0x100>;
				};

				vadc@3100 {
					#address-cells = <0x1>;
					#io-channel-cells = <0x1>;
					#size-cells = <0x0>;
					compatible = "qcom,spmi-adc5";
					interrupt-names = "eoc-int-en-set";
					interrupts = <0x0 0x31 0x0 0x1>;
					io-channel-ranges;
					phandle = <0x1>;
					qcom,adc-vdd-reference = <0x753>;
					reg = <0x3100 0x100>;

					die_temp {
						label = "die_temp";
						qcom,pre-scaling = <0x1 0x1>;
						reg = <0x6>;
					};

					ref_gnd {
						label = "ref_gnd";
						qcom,pre-scaling = <0x1 0x1>;
						reg = <0x0>;
					};

					vref_1p25 {
						label = "vref_1p25";
						qcom,pre-scaling = <0x1 0x1>;
						reg = <0x1>;
					};
				};
			};

			qcom,pm8150@1 {
				#address-cells = <0x2>;
				#size-cells = <0x0>;
				compatible = "qcom,spmi-pmic";
				reg = <0x1 0x0>;
			};
		};
	};

	fragment@1 {
		target = <0xffffffff>;

		__overlay__ {

			pm8150_tz {
				phandle = <0x18>;
				polling-delay = <0x0>;
				polling-delay-passive = <0x64>;
				thermal-governor = "step_wise";
				thermal-sensors = <0x2>;
				wake-capable-sensor;

				trips {

					trip0 {
						hysteresis = <0x0>;
						phandle = <0x7>;
						temperature = <0x17318>;
						type = "passive";
					};

					trip1 {
						hysteresis = <0x0>;
						phandle = <0x8>;
						temperature = <0x1c138>;
						type = "passive";
					};

					trip2 {
						hysteresis = <0x0>;
						temperature = <0x23668>;
						type = "passive";
					};
				};
			};
		};
	};

	fragment@10 {
		target = <0xffffffff>;

		__overlay__ {
			status = "ok";
		};
	};

	fragment@11 {
		target = <0xffffffff>;

		__overlay__ {
			status = "ok";
		};
	};

	fragment@12 {
		target = <0xffffffff>;

		__overlay__ {
			#address-cells = <0x1>;
			#size-cells = <0x0>;
			status = "ok";

			asm330@6a {
				compatible = "st,asm330lhh";
				interrupt-parent = <0xffffffff>;
				interrupts = <0xc 0x1>;
				pinctrl-0 = <0xffffffff 0xffffffff>;
				pinctrl-names = "default";
				reg = <0x6a>;
				vdd-supply = <0xffffffff>;
				vio-supply = <0xffffffff>;
			};
		};
	};

	fragment@13 {
		target = <0xffffffff>;

		__overlay__ {
			status = "disabled";
		};
	};

	fragment@14 {
		target = <0xffffffff>;

		__overlay__ {

			gpio_keys {
				compatible = "gpio-keys";
				label = "gpio-keys";
				pinctrl-0 = <0xc 0xd>;
				pinctrl-names = "default";

				home {
					debounce-interval = <0xf>;
					gpio-key,wakeup;
					gpios = <0xe 0x1 0x1>;
					label = "home";
					linux,can-disable;
					linux,code = <0x66>;
					linux,input-type = <0x1>;
				};

				vol_up {
					debounce-interval = <0xf>;
					gpio-key,wakeup;
					gpios = <0xe 0x6 0x1>;
					label = "volume_up";
					linux,can-disable;
					linux,code = <0x73>;
					linux,input-type = <0x1>;
				};
			};

			qcom,glink {

				modem {
					status = "disabled";
				};
			};

			qcom,ipa@1e00000 {
				phandle = <0x1f>;
				status = "disabled";
			};

			qcom,ipa_fws {
				status = "disabled";
			};

			qcom,lpass@17300000 {
				status = "ok";
			};

			qcom,msm-cdsp-loader {
				status = "ok";
			};

			qcom,msm-ssc-sensors {
				phandle = <0x1e>;
				status = "disabled";
			};

			qcom,npu@0x9800000 {
				status = "ok";
			};

			qcom,rmnet-ipa {
				status = "disabled";
			};

			qcom,spss@1880000 {
				status = "ok";
			};

			qcom,ssc@5c00000 {
				status = "disabled";
			};

			qcom,turing@8300000 {
				status = "ok";
			};

			qcom,venus@aae0000 {
				status = "ok";
			};

			ss5_pwr_ctrl0 {
				compatible = "gnss_sirf";
				pinctrl-0 = <0xffffffff>;
				ssVonoff-gpio = <0xffffffff 0x27 0x1>;
				ssVreset-gpio = <0xffffffff 0xb 0x1>;
			};
		};
	};

	fragment@15 {
		target = <0xffffffff>;

		__overlay__ {
			compatible = "qcom,ufs-phy-qmp-v4";
			status = "ok";
			vdda-phy-max-microamp = <0x1543c>;
			vdda-pll-max-microamp = <0x477c>;
			vdda-pll-supply = <0xffffffff>;
		};
	};

	fragment@16 {
		target = <0xffffffff>;

		__overlay__ {
			qcom,vddp-ref-clk-max-microamp = <0x64>;
			qcom,vddp-ref-clk-supply = <0xffffffff>;
			status = "ok";
			vcc-max-microamp = <0xb71b0>;
			vcc-supply = <0xffffffff>;
			vcc-voltage-level = <0x2d0370 0x2d2a80>;
			vccq2-max-microamp = <0xb71b0>;
			vccq2-supply = <0xffffffff>;
			vdd-hba-fixed-regulator;
			vdd-hba-supply = <0xffffffff>;
		};
	};

	fragment@17 {
		target = <0xffffffff>;

		__overlay__ {
			cd-gpios = <0xe 0x4 0x1>;
			pinctrl-0 = <0xffffffff 0xffffffff 0xffffffff 0xf>;
			pinctrl-1 = <0xffffffff 0xffffffff 0xffffffff 0xf>;
			pinctrl-names = "active", "sleep";
			qcom,vdd-current-level = <0xc8 0xc3500>;
			qcom,vdd-io-current-level = <0xc8 0x55f0>;
			qcom,vdd-io-voltage-level = <0x1b9680 0x2d2a80>;
			qcom,vdd-voltage-level = <0x2d0370 0x2d2a80>;
			status = "ok";
			vdd-io-supply = <0xffffffff>;
			vdd-supply = <0xffffffff>;
		};
	};

	fragment@18 {
		target = <0xffffffff>;

		__overlay__ {
			qcom,default-mode-none;
			qcom,ignore-wakeup-src-in-hostmode;

			dwc3@a600000 {
				maximum-speed = "high-speed";
				usb-phy = <0xffffffff 0xffffffff>;
			};
		};
	};

	fragment@19 {
		target = <0xffffffff>;

		__overlay__ {
			pinctrl-0 = <0xffffffff>;
			pinctrl-names = "default";
			qcom,param-override-seq = <0x43 0x70 0x1 0xb0>;
		};
	};

	fragment@2 {
		target = <0xffffffff>;

		__overlay__ {
			#address-cells = <0x2>;
			#size-cells = <0x0>;

			qcom,pm8150@4 {
				#address-cells = <0x1>;
				#size-cells = <0x1>;
				compatible = "qcom,spmi-pmic";
				reg = <0x4 0x0>;

				clock-controller@5b00 {
					#clock-cells = <0x1>;
					clock-names = "xo";
					clock-output-names = "pm8150_2_div_clk1", "pm8150_2_div_clk2";
					clocks = <0xffffffff 0x0>;
					compatible = "qcom,spmi-clkdiv";
					phandle = <0x19>;
					qcom,num-clkdivs = <0x2>;
					reg = <0x5b00 0x200>;
				};

				pinctrl@c000 {
					#gpio-cells = <0x2>;
					compatible = "qcom,spmi-gpio";
					gpio-controller;
					interrupt-names = "pm8150_2_gpio1", "pm8150_2_gpio3", "pm8150_2_gpio4", "pm8150_2_gpio6", "pm8150_2_gpio8", "pm8150_2_gpio9", "pm8150_2_gpio10";
					interrupts = <0x4 0xc0 0x0 0x0 0x4 0xc2 0x0 0x0 0x4 0xc3 0x0 0x0 0x4 0xc5 0x0 0x0 0x4 0xc7 0x0 0x0 0x4 0xc8 0x0 0x0 0x4 0xc9 0x0 0x0>;
					phandle = <0x1a>;
					qcom,gpios-disallowed = <0x2 0x5 0x7>;
					reg = <0xc000 0xa00>;
				};

				qcom,power-on@800 {
					compatible = "qcom,qpnp-power-on";
					reg = <0x800 0x100>;
				};

				qcom,temp-alarm@2400 {
					#thermal-sensor-cells = <0x0>;
					compatible = "qcom,spmi-temp-alarm";
					interrupts = <0x4 0x24 0x0 0x1>;
					io-channel-names = "thermal";
					io-channels = <0x3 0x6>;
					phandle = <0x4>;
					qcom,temperature-threshold-set = <0x1>;
					reg = <0x2400 0x100>;
				};

				vadc@3100 {
					#address-cells = <0x1>;
					#io-channel-cells = <0x1>;
					#size-cells = <0x0>;
					compatible = "qcom,spmi-adc5";
					interrupt-names = "eoc-int-en-set";
					interrupts = <0x4 0x31 0x0 0x1>;
					io-channel-ranges;
					phandle = <0x3>;
					reg = <0x3100 0x100>;

					die_temp {
						label = "die_temp";
						qcom,pre-scaling = <0x1 0x1>;
						reg = <0x6>;
					};

					ref_gnd {
						label = "ref_gnd";
						qcom,pre-scaling = <0x1 0x1>;
						reg = <0x0>;
					};

					vref_1p25 {
						label = "vref_1p25";
						qcom,pre-scaling = <0x1 0x1>;
						reg = <0x1>;
					};
				};
			};

			qcom,pm8150@5 {
				#address-cells = <0x1>;
				#size-cells = <0x1>;
				compatible = "qcom,spmi-pmic";
				reg = <0x5 0x0>;
			};
		};
	};

	fragment@20 {
		target = <0xffffffff>;

		__overlay__ {
			status = "disabled";
		};
	};

	fragment@21 {
		target = <0xffffffff>;

		__overlay__ {
			qcom,default-mode-host;
			qcom,ignore-wakeup-src-in-hostmode;
			status = "ok";
		};
	};

	fragment@22 {
		target = <0xffffffff>;

		__overlay__ {
			pinctrl-0 = <0xffffffff>;
			pinctrl-names = "default";
			qcom,param-override-seq = <0x1 0xb0>;
		};
	};

	fragment@23 {
		target = <0xffffffff>;

		__overlay__ {
			parts = "vbmeta,boot,system,vendor,dtbo";
		};
	};

	fragment@24 {
		target = <0xffffffff>;

		__overlay__ {

			aquantia,aqc107@pcie_rc1 {
				compatible = "aquantia,aqc-107";
				pci-ids = "1d6a:0001", "1d6a:d107", "1d6a:07b1", "1d6a:87b1", "1d6a:d108", "1d6a:08b1", "1d6a:88b1", "1d6a:d109", "1d6a:09b1", "1d6a:89b1", "1d6a:d100", "1d6a:00b1", "1d6a:80b1", "1d6a:11b1", "1d6a:91b1", "1d6a:51b1", "1d6a:12b1", "1d6a:92b1", "1d6a:52b1";
				phandle = <0x20>;
				qcom,smmu;
				qcom,smmu-attr-atomic;
				qcom,smmu-attr-s1-bypass;
				qcom,smmu-iova-base = <0x0 0x20000000>;
				qcom,smmu-iova-size = <0x0 0x40000000>;
				reg = <0x0 0x0 0x0 0x0 0x0>;
			};
		};
	};

	fragment@25 {
		target = <0xffffffff>;

		__overlay__ {
			qcom,boot-option = <0x0>;
		};
	};

	fragment@26 {
		target = <0xffffffff>;

		__overlay__ {

			qcom,nvme@pcie_rc1 {
				compatible = "qcom,nvme";
				pci-ids = "8086:0953", "8086:0a54", "8086:0a55", "8086:f1a5", "8086:f1a5", "1c58:0003", "1c58:0023", "1c5c:1327", "1c5f:0540", "144d:a821", "144d:a822", "144d:a808", "1d1d:1f1f", "1d1d:2807", "1d1d:2601", "106b:2001", "106b:2003", "1179:0115", "1179:0116";
				phandle = <0x21>;
				qcom,smmu;
				qcom,smmu-attr-atomic;
				qcom,smmu-attr-s1-bypass;
				qcom,smmu-iova-base = <0x0 0x20000000>;
				qcom,smmu-iova-size = <0x0 0x40000000>;
				reg = <0x0 0x0 0x0 0x0 0x0>;
			};
		};
	};

	fragment@27 {
		target = <0xffffffff>;

		__overlay__ {

			dp_hpd_cfg_pins {
				phandle = <0x11>;

				config {
					bias-pull-down;
					drive-strength = <0x2>;
					pins = "gpio48";
				};

				mux {
					function = "gpio";
					pins = "gpio48";
				};
			};

			dp_redriver_en {
				phandle = <0x12>;

				config {
					bias-disable;
					drive-strength = <0x2>;
					output-high;
					pins = "gpio47";
				};

				mux {
					function = "gpio";
					pins = "gpio47";
				};
			};
		};
	};

	fragment@28 {
		target = <0xffffffff>;

		__overlay__ {
			pinctrl-0 = <0x11 0x12>;
			pinctrl-1 = <0x11 0x12>;
			pinctrl-2 = <0x11 0x12>;
			pinctrl-names = "mdss_dp_active", "mdss_dp_sleep", "mdss_dp_hpd_active";
			qcom,dp-hpd-gpio = <0xffffffff 0x30 0x0>;
			qcom,ext-disp = <0x10>;

			qcom,core-supply-entries {
				#address-cells = <0x1>;
				#size-cells = <0x0>;

				qcom,core-supply-entry@0 {
					qcom,supply-disable-load = <0x0>;
					qcom,supply-enable-load = <0x0>;
					qcom,supply-max-voltage = <0x0>;
					qcom,supply-min-voltage = <0x0>;
					qcom,supply-name = "refgen";
					reg = <0x0>;
				};
			};
		};
	};

	fragment@29 {
		target = <0xffffffff>;

		__overlay__ {
			#address-cells = <0x1>;
			#size-cells = <0x1>;

			qcom,msm-ext-disp {
				compatible = "qcom,msm-ext-disp";
				phandle = <0x10>;

				qcom,msm-ext-disp-audio-codec-rx {
					compatible = "qcom,msm-ext-disp-audio-codec-rx";
					phandle = <0x23>;
				};
			};

			qcom,wb-display@0 {
				cell-index = <0x0>;
				compatible = "qcom,wb-display";
				label = "wb_display";
				phandle = <0x13>;
			};

			refgen-regulator@88e7000 {
				compatible = "qcom,refgen-regulator";
				phandle = <0x22>;
				reg = <0x88e7000 0x60>;
				regulator-enable-ramp-delay = <0x5>;
				regulator-name = "refgen";
			};
		};
	};

	fragment@3 {
		target = <0xffffffff>;

		__overlay__ {

			pm8150_2_tz {
				phandle = <0x1b>;
				polling-delay = <0x0>;
				polling-delay-passive = <0x64>;
				thermal-governor = "step_wise";
				thermal-sensors = <0x4>;
				wake-capable-sensor;

				cooling-maps {

					trip0_cpu0 {
						cooling-device = <0xffffffff 0x0 0x0>;
						trip = <0x5>;
					};

					trip1_cpu0 {
						cooling-device = <0xffffffff 0xfffffffd 0xfffffffd>;
						trip = <0x6>;
					};

					trip1_cpu1 {
						cooling-device = <0xffffffff 0xfffffffe 0xfffffffe>;
						trip = <0x6>;
					};

					trip1_cpu2 {
						cooling-device = <0xffffffff 0xfffffffe 0xfffffffe>;
						trip = <0x6>;
					};

					trip1_cpu3 {
						cooling-device = <0xffffffff 0xfffffffe 0xfffffffe>;
						trip = <0x6>;
					};

					trip1_cpu4 {
						cooling-device = <0xffffffff 0xfffffffe 0xfffffffe>;
						trip = <0x6>;
					};

					trip1_cpu5 {
						cooling-device = <0xffffffff 0xfffffffe 0xfffffffe>;
						trip = <0x6>;
					};

					trip1_cpu6 {
						cooling-device = <0xffffffff 0xfffffffe 0xfffffffe>;
						trip = <0x6>;
					};

					trip1_cpu7 {
						cooling-device = <0xffffffff 0xfffffffe 0xfffffffe>;
						trip = <0x6>;
					};
				};

				trips {

					trip0 {
						hysteresis = <0x0>;
						phandle = <0x5>;
						temperature = <0x17318>;
						type = "passive";
					};

					trip1 {
						hysteresis = <0x0>;
						phandle = <0x6>;
						temperature = <0x1c138>;
						type = "passive";
					};

					trip2 {
						hysteresis = <0x0>;
						temperature = <0x23668>;
						type = "passive";
					};
				};
			};

			pm8150_tz {

				cooling-maps {

					trip0_cpu0 {
						cooling-device = <0xffffffff 0x0 0x0>;
						trip = <0x7>;
					};

					trip1_cpu0 {
						cooling-device = <0xffffffff 0xfffffffd 0xfffffffd>;
						trip = <0x8>;
					};

					trip1_cpu1 {
						cooling-device = <0xffffffff 0xfffffffe 0xfffffffe>;
						trip = <0x8>;
					};

					trip1_cpu2 {
						cooling-device = <0xffffffff 0xfffffffe 0xfffffffe>;
						trip = <0x8>;
					};

					trip1_cpu3 {
						cooling-device = <0xffffffff 0xfffffffe 0xfffffffe>;
						trip = <0x8>;
					};

					trip1_cpu4 {
						cooling-device = <0xffffffff 0xfffffffe 0xfffffffe>;
						trip = <0x8>;
					};

					trip1_cpu5 {
						cooling-device = <0xffffffff 0xfffffffe 0xfffffffe>;
						trip = <0x8>;
					};

					trip1_cpu6 {
						cooling-device = <0xffffffff 0xfffffffe 0xfffffffe>;
						trip = <0x8>;
					};

					trip1_cpu7 {
						cooling-device = <0xffffffff 0xfffffffe 0xfffffffe>;
						trip = <0x8>;
					};
				};
			};
		};
	};

	fragment@30 {
		target = <0xffffffff>;

		__overlay__ {
			connectors = <0xffffffff 0xffffffff 0x13>;
		};
	};

	fragment@31 {
		target = <0xffffffff>;

		__overlay__ {

			can-controller@0 {
				qcom,use_qtimer = <0x1>;
			};
		};
	};

	fragment@32 {
		target = <0xffffffff>;

		__overlay__ {

			aquantia,aqc107@pcie_rc1 {
				compatible = "aquantia,aqc-107";
				pci-ids = "1d6a:0001", "1d6a:d107", "1d6a:07b1", "1d6a:87b1", "1d6a:d108", "1d6a:08b1", "1d6a:88b1", "1d6a:d109", "1d6a:09b1", "1d6a:89b1", "1d6a:d100", "1d6a:00b1", "1d6a:80b1", "1d6a:11b1", "1d6a:91b1", "1d6a:51b1", "1d6a:12b1", "1d6a:92b1", "1d6a:52b1";
				phandle = <0x24>;
				qcom,smmu;
				qcom,smmu-attr-atomic;
				qcom,smmu-attr-s1-bypass;
				qcom,smmu-iova-base = <0x0 0x20000000>;
				qcom,smmu-iova-size = <0x0 0x40000000>;
				reg = <0x0 0x0 0x0 0x0 0x0>;
			};
		};
	};

	fragment@33 {
		target = <0xffffffff>;

		__overlay__ {

			asm330@6a {
				compatible = "st,asm330lhh";
				interrupt-parent = <0xffffffff>;
				interrupts = <0x29 0x1>;
				pinctrl-0 = <0xffffffff 0xffffffff>;
				pinctrl-names = "default";
				qcom,use_qtimer = <0x1>;
				reg = <0x6a>;
				vdd-supply = <0xffffffff>;
				vio-supply = <0xffffffff>;
			};
		};
	};

	fragment@4 {
		target = <0xffffffff>;

		__overlay__ {

			bt_qca6174 {
				compatible = "qca,qca6174";
				phandle = <0x1c>;
				pinctrl-0 = <0xffffffff>;
				pinctrl-names = "default";
				qca,bt-chip-pwd-supply = <0xa>;
				qca,bt-reset-gpio = <0xffffffff 0xac 0x0>;
				qca,bt-vdd-5c-current-level = <0x0>;
				qca,bt-vdd-5c-supply = <0xffffffff>;
				qca,bt-vdd-5c-voltage-level = <0x1f20c0 0x1f20c0>;
				qca,bt-vdd-pa-supply = <0x9>;
				qca,bt-vdd-vh-current-level = <0x6ddd0>;
				qca,bt-vdd-vh-supply = <0xffffffff>;
				qca,bt-vdd-vh-voltage-level = <0x1cfde0 0x1cfde0>;
				qca,bt-vdd-vl-current-level = <0x0>;
				qca,bt-vdd-vl-supply = <0xffffffff>;
				qca,bt-vdd-vl-voltage-level = <0x101918 0x101918>;
				qca,bt-vdd-vm-current-level = <0x0>;
				qca,bt-vdd-vm-supply = <0xffffffff>;
				qca,bt-vdd-vm-voltage-level = <0x14e790 0x14e790>;
			};

			qcom,cnss-qca-converged {
				#address-cells = <0x1>;
				#size-cells = <0x1>;
				compatible = "qcom,cnss-qca-converged";
				phandle = <0x1d>;
				pinctrl-0 = <0xffffffff>;
				pinctrl-1 = <0xffffffff>;
				pinctrl-names = "wlan_en_active", "wlan_en_sleep";
				qcom,bus-type = <0x0>;
				qcom,converged-dt;
				qcom,msm-bus,name = "msm-cnss";
				qcom,msm-bus,num-cases = <0x6>;
				qcom,msm-bus,num-paths = <0x1>;
				qcom,msm-bus,vectors-KBps = <0x2d 0x200 0x0 0x0 0x2d 0x200 0x8ca 0x61a80 0x2d 0x200 0x1d4c 0xc3500 0x2d 0x200 0x7530 0x1b8a00 0x2d 0x200 0x186a0 0x1b8a00 0x2d 0x200 0x2ab98 0x5eec00>;
				qcom,notify-modem-status;
				qcom,vdd-wlan-ctrl1-info = <0x0 0x0 0x0 0x0>;
				qcom,vdd-wlan-ctrl2-info = <0x0 0x0 0x0 0x0>;
				qcom,wlan-rc-num = <0x0>;
				ranges = <0x10000000 0x10000000 0x10000000 0x20000000 0x20000000 0x10000 0xa0000000 0xa0000000 0x10000000 0xb0000000 0xb0000000 0x10000>;
				vdd-wlan-aon-supply = <0xffffffff>;
				vdd-wlan-ctrl1-supply = <0x9>;
				vdd-wlan-ctrl2-supply = <0xa>;
				vdd-wlan-rfa1-supply = <0xffffffff>;
				vdd-wlan-rfa2-supply = <0xffffffff>;
				vdd-wlan-rfa3-supply = <0xffffffff>;
				vdd-wlan-supply = <0xb>;
				wlan-en-gpio = <0xffffffff 0xa9 0x0>;
				wlan_vregs = "vdd-wlan-ctrl1", "vdd-wlan-ctrl2";

				chip_cfg@0 {
					qcom,smmu-s1-enable;
					qcom,vdd-wlan-info = <0x0 0x0 0x0 0xa>;
					qcom,wlan-ramdump-dynamic = <0x200000>;
					reg = <0x10000000 0x10000000 0x20000000 0x10000>;
					reg-names = "smmu_iova_base", "smmu_iova_ipa";
					supported-ids = <0x3e>;
					wlan_vregs = "vdd-wlan";
				};

				chip_cfg@1 {
					mhi,max-channels = <0x1e>;
					mhi,timeout = <0x2710>;
					qcom,vdd-wlan-aon-info = <0x101918 0x101918 0x0 0x0>;
					qcom,vdd-wlan-rfa1-info = <0x14e790 0x14e790 0x0 0x0>;
					qcom,vdd-wlan-rfa2-info = <0x1f20c0 0x1f20c0 0x0 0x0>;
					qcom,vdd-wlan-rfa3-info = <0x1cfde0 0x1cfde0 0x6ddd0 0x0>;
					qcom,wlan-ramdump-dynamic = <0x400000>;
					reg = <0xa0000000 0x10000000 0xb0000000 0x10000>;
					reg-names = "smmu_iova_base", "smmu_iova_ipa";
					supported-ids = <0x1101>;
					wlan_vregs = "vdd-wlan-aon", "vdd-wlan-rfa1", "vdd-wlan-rfa2", "vdd-wlan-rfa3";

					mhi_channels {
						#address-cells = <0x1>;
						#size-cells = <0x0>;

						mhi_chan@0 {
							label = "LOOPBACK";
							mhi,chan-dir = <0x1>;
							mhi,data-type = <0x0>;
							mhi,doorbell-mode = <0x2>;
							mhi,ee = <0x14>;
							mhi,event-ring = <0x1>;
							mhi,num-elements = <0x20>;
							reg = <0x0>;
						};

						mhi_chan@1 {
							label = "LOOPBACK";
							mhi,chan-dir = <0x2>;
							mhi,data-type = <0x0>;
							mhi,doorbell-mode = <0x2>;
							mhi,ee = <0x14>;
							mhi,event-ring = <0x1>;
							mhi,num-elements = <0x20>;
							reg = <0x1>;
						};

						mhi_chan@20 {
							label = "IPCR";
							mhi,auto-start;
							mhi,chan-dir = <0x1>;
							mhi,data-type = <0x1>;
							mhi,doorbell-mode = <0x2>;
							mhi,ee = <0x14>;
							mhi,event-ring = <0x1>;
							mhi,num-elements = <0x20>;
							reg = <0x14>;
						};

						mhi_chan@21 {
							label = "IPCR";
							mhi,auto-queue;
							mhi,auto-start;
							mhi,chan-dir = <0x2>;
							mhi,data-type = <0x0>;
							mhi,doorbell-mode = <0x2>;
							mhi,ee = <0x14>;
							mhi,event-ring = <0x1>;
							mhi,num-elements = <0x20>;
							reg = <0x15>;
						};

						mhi_chan@4 {
							label = "DIAG";
							mhi,chan-dir = <0x1>;
							mhi,data-type = <0x0>;
							mhi,doorbell-mode = <0x2>;
							mhi,ee = <0x14>;
							mhi,event-ring = <0x1>;
							mhi,num-elements = <0x20>;
							reg = <0x4>;
						};

						mhi_chan@5 {
							label = "DIAG";
							mhi,chan-dir = <0x2>;
							mhi,data-type = <0x0>;
							mhi,doorbell-mode = <0x2>;
							mhi,ee = <0x14>;
							mhi,event-ring = <0x1>;
							mhi,num-elements = <0x20>;
							reg = <0x5>;
						};
					};

					mhi_events {

						mhi_event@0 {
							mhi,brstmode = <0x2>;
							mhi,data-type = <0x1>;
							mhi,intmod = <0x1>;
							mhi,msi = <0x1>;
							mhi,num-elements = <0x20>;
							mhi,priority = <0x1>;
						};

						mhi_event@1 {
							mhi,brstmode = <0x2>;
							mhi,intmod = <0x1>;
							mhi,msi = <0x2>;
							mhi,num-elements = <0x100>;
							mhi,priority = <0x1>;
						};
					};
				};

				chip_cfg@2 {
					mhi,bhie-offset = <0x324>;
					mhi,ee = <0x3 0x4>;
					mhi,ee-names = "SBL", "RDDM";
					mhi,max-channels = <0x1e>;
					mhi,timeout = <0x2710>;
					qcom,vdd-wlan-aon-info = <0x101918 0x101918 0x0 0x0>;
					qcom,vdd-wlan-rfa1-info = <0x14e790 0x14e790 0x0 0x0>;
					qcom,vdd-wlan-rfa2-info = <0x1f20c0 0x1f20c0 0x0 0x0>;
					qcom,vdd-wlan-rfa3-info = <0x1cfde0 0x1cfde0 0x0 0x0>;
					qcom,wlan-ramdump-dynamic = <0x300000>;
					reg = <0xa0000000 0x10000000 0xb0000000 0x10000>;
					reg-names = "smmu_iova_base", "smmu_iova_ipa";
					supported-ids = <0x1102>;
					wlan_vregs = "vdd-wlan-aon", "vdd-wlan-rfa1", "vdd-wlan-rfa2", "vdd-wlan-rfa3";

					mhi_channels {
						#address-cells = <0x1>;
						#size-cells = <0x0>;

						mhi_chan@0 {
							label = "LOOPBACK";
							mhi,chan-dir = <0x1>;
							mhi,data-type = <0x0>;
							mhi,doorbell-mode = <0x2>;
							mhi,ee = <0x14>;
							mhi,event-ring = <0x1>;
							mhi,num-elements = <0x20>;
							reg = <0x0>;
						};

						mhi_chan@1 {
							label = "LOOPBACK";
							mhi,chan-dir = <0x2>;
							mhi,data-type = <0x0>;
							mhi,doorbell-mode = <0x2>;
							mhi,ee = <0x14>;
							mhi,event-ring = <0x1>;
							mhi,num-elements = <0x20>;
							reg = <0x1>;
						};

						mhi_chan@16 {
							label = "IPCR";
							mhi,auto-start;
							mhi,chan-dir = <0x1>;
							mhi,data-type = <0x1>;
							mhi,doorbell-mode = <0x2>;
							mhi,ee = <0x14>;
							mhi,event-ring = <0x1>;
							mhi,num-elements = <0x20>;
							reg = <0x10>;
						};

						mhi_chan@17 {
							label = "IPCR";
							mhi,auto-queue;
							mhi,auto-start;
							mhi,chan-dir = <0x2>;
							mhi,data-type = <0x0>;
							mhi,doorbell-mode = <0x2>;
							mhi,ee = <0x14>;
							mhi,event-ring = <0x1>;
							mhi,num-elements = <0x20>;
							reg = <0x11>;
						};

						mhi_chan@4 {
							label = "DIAG";
							mhi,chan-dir = <0x1>;
							mhi,data-type = <0x0>;
							mhi,doorbell-mode = <0x2>;
							mhi,ee = <0x14>;
							mhi,event-ring = <0x1>;
							mhi,num-elements = <0x20>;
							reg = <0x4>;
						};

						mhi_chan@5 {
							label = "DIAG";
							mhi,chan-dir = <0x2>;
							mhi,data-type = <0x0>;
							mhi,doorbell-mode = <0x2>;
							mhi,ee = <0x14>;
							mhi,event-ring = <0x1>;
							mhi,num-elements = <0x20>;
							reg = <0x5>;
						};
					};

					mhi_events {

						mhi_event@0 {
							mhi,brstmode = <0x2>;
							mhi,data-type = <0x1>;
							mhi,intmod = <0x1>;
							mhi,msi = <0x1>;
							mhi,num-elements = <0x20>;
							mhi,priority = <0x1>;
						};

						mhi_event@1 {
							mhi,brstmode = <0x2>;
							mhi,intmod = <0x1>;
							mhi,msi = <0x2>;
							mhi,num-elements = <0x100>;
							mhi,priority = <0x1>;
						};
					};
				};
			};

			qcom,cnss-qca6390@a0000000 {
				status = "disabled";
			};

			vreg_conn_1p8 {
				compatible = "regulator-fixed";
				enable-active-high;
				gpio = <0xffffffff 0xad 0x0>;
				phandle = <0xa>;
				pinctrl-0 = <0xffffffff>;
				pinctrl-names = "default";
				regulator-name = "vreg_conn_1p8";
				startup-delay-us = <0xfa0>;
			};

			vreg_conn_pa {
				compatible = "regulator-fixed";
				enable-active-high;
				gpio = <0xffffffff 0xae 0x0>;
				phandle = <0x9>;
				pinctrl-0 = <0xffffffff>;
				pinctrl-names = "default";
				regulator-name = "vreg_conn_pa";
				startup-delay-us = <0xfa0>;
			};

			vreg_wlan {
				compatible = "qcom,stub-regulator";
				phandle = <0xb>;
				regulator-name = "vreg_wlan";
			};
		};
	};

	fragment@5 {
		target = <0xffffffff>;

		__overlay__ {
			status = "ok";
		};
	};

	fragment@6 {
		target = <0xffffffff>;

		__overlay__ {
			#address-cells = <0x1>;
			#size-cells = <0x0>;
			status = "ok";

			can-controller@0 {
				compatible = "qcom,nxp,mpc5746c";
				interrupt-parent = <0xffffffff>;
				interrupts = <0x26 0x0>;
				qcom,bits-per-word = <0x8>;
				qcom,clk-freq-mhz = <0x2625a00>;
				qcom,max-can-channels = <0x1>;
				qcom,support-can-fd;
				reg = <0x0>;
				spi-max-frequency = <0x4c4b40>;
			};
		};
	};

	fragment@7 {
		target = <0xffffffff>;

		__overlay__ {
			status = "ok";
		};
	};

	fragment@8 {
		target = <0xffffffff>;

		__overlay__ {
			status = "ok";
		};
	};

	fragment@9 {
		target = <0xffffffff>;

		__overlay__ {
			status = "disabled";
		};
	};
};
